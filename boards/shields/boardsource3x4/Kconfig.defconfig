## boards/shields/boardsource3x4/Kconfig.defconfig
```kconfig
if SHIELD_BOARDSOURCE3X4

# Name must be less than 16 characters long!
config ZMK_KEYBOARD_NAME
    default "boardsource3x4"

endif
```

## boards/shields/boardsource3x4/Kconfig.shield
```kconfig
# No whitespace after the comma or in your keyboard name!
config SHIELD_BOARDSOURCE3X4
    def_bool $(shields_list_contains,boardsource3x4)
```
